/dts-v1/;
/plugin/;


/ {
	compatible = "brcm,bcm2835";

	fragment@0 {
		target = <&spi0_cs_pins>;
		frag0: __overlay__ {
			brcm,pins = <8 7 6>;
		};
	};

	fragment@1 {
		target = <&spi0>;
		frag1: __overlay__ {
			#address-cells = <1>;
			#size-cells = <0>;

			cs-gpios = <&gpio 8 1>, <&gpio 7 1>, <&gpio 6 1>;
			status = "okay";

			spidev0_2: spidev@2 {
				compatible = "spidev";
				reg = <2>;	/* CE2 */
				#address-cells = <1>;
				#size-cells = <0>;
				spi-max-frequency = <125000000>;
			};
		};
	};

	__overrides__ {
		cs0_pin  = <&frag0>,"brcm,pins:0",
			   <&frag1>,"cs-gpios:4";
		cs1_pin  = <&frag0>,"brcm,pins:4",
			   <&frag1>,"cs-gpios:16";
		cs2_pin  = <&frag0>,"brcm,pins:8",
			   <&frag1>,"cs-gpios:28";
		cs2_spidev = <&spidev0_2>, "status";
 	};
};

